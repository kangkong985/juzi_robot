## BSP/stm32f407-juicy/board/Kconfig
```kconfig
menu "Hardware Drivers Config"

config SOC_STM32F407VE
    bool
    select SOC_SERIES_STM32F4
    default y

menu "Onboard Peripheral Drivers"

endmenu

menu "On-chip Peripheral Drivers"

    config BSP_USING_GPIO
        bool "Enable GPIO"
        select RT_USING_PIN
        default y

    menuconfig BSP_USING_UART
        bool "Enable UART"
        default y
        select RT_USING_SERIAL
        if BSP_USING_UART
            config BSP_USING_UART1
                bool "Enable UART1"
                default y

            config BSP_UART1_RX_USING_DMA
                bool "Enable UART1 RX DMA"
                depends on BSP_USING_UART1 && RT_SERIAL_USING_DMA
                default n
        endif
    
    menuconfig BSP_USING_PWM
        bool "Enable pwm"
        default n
        select RT_USING_PWM
        if BSP_USING_PWM
        menuconfig BSP_USING_PWM4
            bool "Enable timer4 output pwm"
            default n
            if BSP_USING_PWM4
                config BSP_USING_PWM4_CH1
                    bool "Enable PWM4 channel1"
                    default n
                config BSP_USING_PWM4_CH2
                    bool "Enable PWM4 channel2"
                    default n                    
                config BSP_USING_PWM4_CH3
                    bool "Enable PWM4 channel3"
                    default n                    
                config BSP_USING_PWM4_CH4
                    bool "Enable PWM4 channel4"
                    default n                    
                    
            endif
        endif
    
	config BSP_USING_SPI1
		bool "Enable SPI1 BUS"
		select RT_USING_SPI
		default n
		
endmenu

menu "Board extended module Drivers"

endmenu
 
endmenu
```
